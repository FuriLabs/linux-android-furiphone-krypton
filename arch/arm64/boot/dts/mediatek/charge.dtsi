
&i2c0 {
	fuelguage@62 {
		compatible = "cellwise,cw2015";
		reg = <0x62>;
		batinfo = /bits/ 8 <0x18 0x0A 0x6C 0x69 0x6A 0x6A 0x69 0x67 0x5D 0x6A 0x62 0x54 0x5F 0x5A 0x49 0x3F
							0x36 0x2C 0x26 0x22 0x24 0x32 0x44 0x47 0x2A 0x49 0x0B 0x85 0x23 0x44 0x41 0x47
							0x50 0x56 0x58 0x58 0x3E 0x1A 0x70 0x4C 0x0B 0x2B 0x22 0x52 0x88 0x94 0x9C 0x23
							0x58 0x79 0x97 0x97 0x80 0xD4 0xFF 0xCB 0x2F 0x00 0x64 0xA5 0xB5 0x0E 0x0A 0xB1>;
	};
};