## drivers/misc/mediatek/hardware_info/Kconfig
```kconfig
config PRIZE_HARDWARE_INFO
  bool "HARDWARE_INFO"
  default n
  help
    Display some hardware info through sysfs
```

## drivers/misc/mediatek/performance/Kconfig
```kconfig
config MTK_CPU_CTRL_CFP
	tristate "CPU CTRL Ceiling-Fool-Proof"
	depends on MTK_LOAD_TRACKER
	help
	  MTK_CPU_CTRL_CFP is the kernel config of CPU controller
	  Ceiling-Fool-Proof Mechanism designed by MTK. CPU controller
	  will free CPU frequency ceiling during heavy CPU loading.
	  This function depends on MTK_LOAD_TRACKER.
```

## drivers/misc/prize/Kconfig
```kconfig
#prize-add prize-wangyunqing-20181110-start
source "drivers/misc/prize/hardware_info/Kconfig"
#prize-add prize-wangyunqing-20181110-end

#/*prize add by zhuzhengjiang for camera ldo wl2868c 20220309  start*/ 
source "drivers/misc/prize/wl2868c/Kconfig"
#/*prize add by zhuzhengjiang for camera ldo wl2868c 20220309  end*/ 
```
